## app/hello_app/Kconfig
```kconfig
#
# For a description of the syntax of this configuration file,
# see the file kconfig-language.txt in the NuttX tools repository.
#

config LVX_USE_DEMO_CONTEST2026_000_HELLO_APP
	bool "Contest 2026 team 000 hello app"
	default n
	---help---
		Enable the contest 2026 team 000 hello app demo.

config LVX_USE_DEMO_CONTEST2026_128_WSS_TEST
	bool "Contest 2026 team 128 secure WebSocket test"
	default n
	depends on NET_TCP
	depends on NET_TCPPROTO_OPTIONS
	select LIBUV
	select CRYPTO_MBEDTLS
	select OPENSSL_MBEDTLS_WRAPPER
	select NETUTILS_LIBWEBSOCKETS
	---help---
		Build the wss_test NSH command.  It isolates DNS, TCP, TLS and the
		WebSocket HTTP Upgrade from the XiaoZhi application.

if LVX_USE_DEMO_CONTEST2026_128_WSS_TEST

config CONTEST2026_128_WSS_TEST_URL
	string "Secure WebSocket URL"
	default "wss://api.tenclass.net/xiaozhi/v1/"

config CONTEST2026_128_WSS_TEST_TIMEOUT
	int "Connection timeout in seconds"
	range 3 120
	default 15

config CONTEST2026_128_WSS_TEST_TLS_ALLOW_INSECURE
	bool "Allow unverified TLS for board bring-up"
	default n
	help
		Disable certificate and hostname verification.  Use only to isolate
		transport bring-up before a CA bundle is provisioned.

endif

config LVX_USE_DEMO_CONTEST2026_128_LCD_TEST
	bool "Contest 2026 team 128 LCD test"
	default n
	depends on LCD_DEV
	---help---
		Draw RGB565 color bars, a border, and a center cross through the
		NuttX /dev/lcd0 character-device interface.

config LVX_USE_DEMO_CONTEST2026_128_TOUCH_TEST
	bool "Contest 2026 team 128 touchscreen input test"
	default n
	depends on INPUT_TOUCHSCREEN
	---help---
		Open a NuttX touchscreen character device, report its ioctl
		capabilities, and print touch samples received through poll/read.

config LVX_USE_DEMO_CONTEST2026_128_PPA_TEST
	bool "Contest 2026 team 128 ESP32-P4 PPA functional test"
	default n
	depends on ESP32P4_PPA
	---help---
		Build the ppa_test NSH application.  It validates PPA output against
		an independent CPU reference and checks DMA guard regions.

config LVX_USE_DEMO_CONTEST2026_128_LVGL_PPA
	bool "Contest 2026 team 128 LVGL ESP32-P4 PPA demo"
	default n
	depends on ESP32P4_PPA
	depends on GRAPHICS_LVGL
	depends on LV_USE_NUTTX
	depends on LV_USE_NUTTX_LCD || VIDEO_FB
	---help---
		Build the lvgl_ppa NSH application and the application-side LVGL 9.1
		draw-unit adapter.  The adapter accelerates fills, RGB/A8/ARGB variable
		images, alpha blending, color keying, scaling, and right-angle rotation
		through PPA, leaving unsupported tasks to software.  Both the NuttX
		LCD character device and framebuffer backends are supported.  When
		the LVGL widgets demo is enabled, also build the lvgl_widget application
		with the same PPA draw unit registered before creating the widgets UI.
		When the LVGL benchmark demo is enabled, build two otherwise identical
		benchmark applications: lvglbench_ppa with the PPA draw unit registered,
		and lvglbench using LVGL's software renderer only.
```

## app/xiaozhi/Kconfig
```kconfig
config LVX_USE_DEMO_CONTEST2026_128_XIAOZHI
	bool "Contest 2026 team 128 XiaoZhi AI client"
	default n
	depends on LIBCXX
	depends on AUDIO
	depends on NET_TCP
	depends on NET_TCPPROTO_OPTIONS
	depends on GRAPHICS_LVGL
	depends on LV_USE_NUTTX
	depends on LV_USE_NUTTX_LCD || VIDEO_FB
	select LIB_OPUS
	select LIB_CURL
	select NETUTILS_CJSON
	select LIBUV
	select CRYPTO_MBEDTLS
	select OPENSSL_MBEDTLS_WRAPPER
	select NETUTILS_LIBWEBSOCKETS
	select WIRELESS_WAPI
	select NETUTILS_DHCPC
	select NETUTILS_NETLIB
	---help---
		Enable the XiaoZhi voice assistant client port.  The application uses
		only NuttX/POSIX interfaces plus openvela's packaged cJSON, Opus and
		libwebsockets libraries.

if LVX_USE_DEMO_CONTEST2026_128_XIAOZHI

config CONTEST2026_128_XIAOZHI_PPA
	bool "Accelerate XiaoZhi LVGL drawing with ESP32-P4 PPA"
	default y
	depends on ESP32P4_PPA
	---help---
		Register the ESP32-P4 PPA LVGL draw unit before creating the XiaoZhi
		interface. Unsupported operations continue to use LVGL software drawing.

config CONTEST2026_128_XIAOZHI_PROGNAME
	string "Program name"
	default "xiaozhi"

config CONTEST2026_128_XIAOZHI_PRIORITY
	int "Main task priority"
	default 100

config CONTEST2026_128_XIAOZHI_STACKSIZE
	int "Main task stack size"
	default 32768

config CONTEST2026_128_XIAOZHI_GUI_STACKSIZE
	int "LVGL worker stack size"
	range 8192 131072
	default 16384

config CONTEST2026_128_XIAOZHI_WIFI_STACKSIZE
	int "WiFi worker stack size"
	range 4096 32768
	default 8192
	help
		Stack used by the non-blocking WAPI scan/association worker.  The DHCP
		client creates its own short-lived worker while an address is acquired.

config CONTEST2026_128_XIAOZHI_AUDIO_STACKSIZE
	int "Audio worker stack size"
	range 4096 131072
	default 32768
	help
		Stack size used independently by the capture and playback workers.
		The Opus encoder has individual call frames larger than 11 KiB, so
		leave enough headroom for its nested analysis and SILK/CELT routines.

config CONTEST2026_128_XIAOZHI_AUDIO_DIAGNOSTICS
	bool "Enable audio and I2S diagnostic logs"
	default n
	help
		Print the captured PCM peak/mean amplitude, Opus frame/byte counts,
		and the XiaoZhi audio-domain bring-up trace.  Enable this while
		diagnosing the audio path, then disable it for normal use.

config CONTEST2026_128_XIAOZHI_CAPTURE_SLOT_COUNT
	int "Physical I2S capture slots per sample"
	range 1 2
	default 2
	help
		Number of interleaved 16-bit slots delivered by the NuttX I2S
		driver for each microphone sample.  ESP32-P4 standard I2S uses two
		physical slots even though the ES8311 ADC is mono.  The capture
		adapter selects the active slot before passing 16-kHz mono PCM to
		Opus.  Use 1 only for a lower half that already returns mono PCM.

config CONTEST2026_128_XIAOZHI_WEBSOCKET_STACKSIZE
	int "WebSocket/TLS worker stack size"
	range 8192 131072
	default 24576

config CONTEST2026_128_XIAOZHI_WEBSOCKET_URL
	string "XiaoZhi WebSocket URL"
	default "wss://api.tenclass.net/xiaozhi/v1/"

config CONTEST2026_128_XIAOZHI_OTA_URL
	string "XiaoZhi activation/version URL"
	default "https://api.tenclass.net/xiaozhi/ota/"
	help
		The upstream version endpoint also returns the pairing code and the
		authenticated WebSocket URL/token.  It is required even when firmware
		upgrades are not enabled in the NuttX port.

config CONTEST2026_128_XIAOZHI_LANGUAGE
	string "Device language sent during activation"
	default "zh-CN"

config CONTEST2026_128_XIAOZHI_BOARD_TYPE
	string "XiaoZhi board type"
	default "esp32-p4-function-ev-board"

config CONTEST2026_128_XIAOZHI_BOARD_NAME
	string "XiaoZhi board name"
	default "esp32-p4-function-ev-board"

config CONTEST2026_128_XIAOZHI_BOARD_MANUFACTURER
	string "XiaoZhi board manufacturer"
	default "espressif"

config CONTEST2026_128_XIAOZHI_APP_VERSION
	string "XiaoZhi application version"
	default "0.1.0"

config CONTEST2026_128_XIAOZHI_TOKEN
	string "Optional WebSocket bearer token"
	default ""

config CONTEST2026_128_XIAOZHI_TLS_CA_PATH
	string "TLS CA certificate path"
	default ""
	---help---
		PEM CA bundle used to verify a wss:// server.  Leave empty only when
		TLS_ALLOW_INSECURE is enabled for initial board bring-up.

config CONTEST2026_128_XIAOZHI_TLS_ALLOW_INSECURE
	bool "Allow unverified TLS during bring-up"
	default n
	---help---
		Disable server certificate and hostname verification.  This makes a
		board without a provisioned CA bundle usable for initial bring-up,
		but must be disabled for production firmware.

config CONTEST2026_128_XIAOZHI_PROTOCOL_VERSION
	int "Binary protocol version"
	range 1 3
	default 1

config CONTEST2026_128_XIAOZHI_CAPTURE_DEVPATH
	string "NuttX capture audio device"
	default "/dev/audio/pcm_in0"

config CONTEST2026_128_XIAOZHI_PLAYBACK_DEVPATH
	string "NuttX playback audio device"
	default "/dev/audio/pcm0"

config CONTEST2026_128_XIAOZHI_CLIENT_ID_PATH
	string "Persistent client identifier file"
	default "/data/xiaozhi-client-id"

config CONTEST2026_128_XIAOZHI_FB_DEVPATH
	string "LVGL display device"
	default "/dev/lcd0" if LV_USE_NUTTX_LCD
	default "/dev/fb0"

config CONTEST2026_128_XIAOZHI_INPUT_DEVPATH
	string "LVGL touchscreen device"
	default "/dev/input0"

endif
```

## board/esp32p4/esp32p4-function-ev-board/Kconfig
```kconfig
#
# For a description of the syntax of this configuration file,
# see the file kconfig-language.txt in the NuttX tools repository.
#

if ARCH_BOARD_CUSTOM

source "../apps/vendor/espressif/boards/esp32p4/common/Kconfig"

config ESP32P4_FUNCTION_EV_BOARD_TOUCHSCREEN
	bool "GT911 touchscreen on the Function EV Board"
	default n
	depends on ESPRESSIF_I2C0
	select INPUT_TOUCHSCREEN
	select SCHED_LPWORK
	---help---
		Enable the polled GT911 touchscreen on the official 1024x600
		MIPI-DSI display adapter.  The controller shares I2C0 with other
		board devices and is registered as /dev/input0.  The adapter does
		not route the GT911 interrupt or reset signals to the ESP32-P4.

config ESP32P4_FUNCTION_EV_BOARD_SC2336
	bool "Experimental SC2336 MIPI-CSI camera"
	default n
	depends on ESPRESSIF_I2C0 && ESPRESSIF_MIPI_CSI
	help
		Enable the SC2336 camera on I2C0 at address 0x30 and register it as
		/dev/video0.  The fixed mode is 1280x720 at 30 fps, two CSI lanes at
		405 Mbps/lane, packed BGGR RAW10.

		The current NuttX imgdata ABI lacks Bayer RAW10, so V4L2 ENTROPY is
		used only as an experimental opaque transport token.  This is not an
		ISP or a standard Bayer V4L2 ABI.  Camera XCLK must be supplied by the
		module because the official board BSP marks XCLK as GPIO_NUM_NC.

if AUDIO_ES8311

config ESP32P4_FUNCTION_EV_BOARD_ES8311_I2C_PORT
	int "ES8311 I2C port"
	range 0 1
	default 0
	---help---
		I2C controller connected to the ES8311 control interface.  Select
		SDA and SCL with the corresponding ESPRESSIF_I2C<n> options.

config ESP32P4_FUNCTION_EV_BOARD_ES8311_I2C_ADDRESS
	hex "ES8311 I2C address"
	range 0x00 0x7f
	default 0x18

config ESP32P4_FUNCTION_EV_BOARD_ES8311_I2C_FREQUENCY
	int "ES8311 I2C frequency"
	range 10000 1000000
	default 400000

config ESP32P4_FUNCTION_EV_BOARD_ES8311_I2S_PORT
	int "ES8311 I2S port"
	range 0 0
	default 0
	---help---
		I2S controller connected to the ES8311 digital audio interface.
		MCLK, BCLK, WS, DIN and DOUT remain configurable through the
		ESPRESSIF_I2S0_* options.

config ESP32P4_FUNCTION_EV_BOARD_ES8311_PA_ENABLE
	bool "Control an external speaker amplifier enable pin"
	default n
	---help---
		Enable this when the ES8311 speaker output is connected through an
		external power amplifier with a GPIO enable input.  Leave it disabled
		until the board wiring and active level are known.

config ESP32P4_FUNCTION_EV_BOARD_ES8311_PA_PIN
	int "External speaker amplifier enable GPIO"
	range 0 54
	default 0
	depends on ESP32P4_FUNCTION_EV_BOARD_ES8311_PA_ENABLE

config ESP32P4_FUNCTION_EV_BOARD_ES8311_PA_ACTIVE_HIGH
	bool "External speaker amplifier enable is active high"
	default y
	depends on ESP32P4_FUNCTION_EV_BOARD_ES8311_PA_ENABLE

endif # AUDIO_ES8311

endif # ARCH_BOARD_CUSTOM
```

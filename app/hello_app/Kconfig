## chip/esp32p4/Kconfig
```kconfig
#
# For a description of the syntax of this configuration file,
# see the file kconfig-language.txt in the NuttX tools repository.
#

if ARCH_CHIP_CUSTOM

config ARCH_CHIP_ESP32P4
	bool "ESP32-P4"
	select ARCH_RV32
	select ARCH_RV_ISA_M
	select ARCH_RV_ISA_A
	select ARCH_RV_ISA_C
	select ARCH_VECNOTIRQ
	select ARCH_HAVE_BOOTLOADER if !ESPRESSIF_SIMPLE_BOOT
	select ARCH_HAVE_I2CRESET
	select ARCH_HAVE_FPU
	select ARCH_HAVE_MPU
	select ARCH_HAVE_RAMFUNCS
	select ARCH_HAVE_RESET
	select ARCH_HAVE_RNG
	select ARCH_HAVE_TICKLESS
	select ARCH_HAVE_MULTICPU
	select LIBC_ARCH_MEMCPY
	select LIBC_ARCH_MEMCHR
	select LIBC_ARCH_MEMCMP
	select LIBC_ARCH_MEMMOVE
	select LIBC_ARCH_MEMSET
	select LIBC_ARCH_STRCHR
	select LIBC_ARCH_STRCMP
	select LIBC_ARCH_STRCPY
	select LIBC_ARCH_STRLCPY
	select LIBC_ARCH_STRNCPY
	select LIBC_ARCH_STRLEN
	select LIBC_ARCH_STRNLEN
	select LIBC_SEM_MUTEX_NOINLINE
	select LIBC_ATOMIC_IRQ
	select ONESHOT
	select ONESHOT_COUNT
	select ONESHOT_FAST_DIVISION
	select ARCH_MINIMAL_VECTORTABLE
	---help---
		Espressif ESP32-P4 (RV32IMC).


source "../vendor/espressif/chips/esp32p4/espressif/Kconfig"
source "../vendor/espressif/chips/esp32p4/espressif/esp_hosted/Kconfig"


config ESP32P4_SELECTS_REV_LESS_V3
	bool "Select ESP32-P4 revisions <3.0 (No >=3.x Support)"
	default n
	---help---
		Select this option to support ESP32-P4 revisions 0.x and 1.x.
		Revisions higher than 3.0 (included) and revisions less than 3.0
		have huge hardware difference.
		Revisions higher than 3.0 (included) is not compatible with 0.x and 1.x.

choice ESP32P4_REV_MIN
	prompt "Minimum Supported ESP32-P4 Revision"
	default ESP32P4_REV_MIN_301
	---help---
		Required minimum chip revision. ESP-IDF will check for it and
		reject to boot if the chip revision fails the check.
		This ensures the chip used will have some modifications (features, or bugfixes).

		The complied binary will only support chips above this revision,
		this will also help to reduce binary size.

config ESP32P4_REV_MIN_0
	depends on ESP32P4_SELECTS_REV_LESS_V3
	bool "Rev v0.0"

config ESP32P4_REV_MIN_1
	depends on ESP32P4_SELECTS_REV_LESS_V3
	bool "Rev v0.1"

config ESP32P4_REV_MIN_100
	depends on ESP32P4_SELECTS_REV_LESS_V3
	bool "Rev v1.0"

config ESP32P4_REV_MIN_300
	bool "Rev v3.0"
	depends on !ESP32P4_SELECTS_REV_LESS_V3

config ESP32P4_REV_MIN_301
	bool "Rev v3.1"
	depends on !ESP32P4_SELECTS_REV_LESS_V3

endchoice # ESP32P4_REV_MIN

config ESP32P4_REV_MIN_FULL
	int
	default 0 if ESP32P4_REV_MIN_0
	default 1 if ESP32P4_REV_MIN_1
	default 100 if ESP32P4_REV_MIN_100
	default 300 if ESP32P4_REV_MIN_300
	default 301 if ESP32P4_REV_MIN_301

config ESP_REV_MIN_FULL
	int
	default ESP32P4_REV_MIN_FULL

config ESP32P4_REV_MAX_FULL
	int
	default 399 if !ESP32P4_SELECTS_REV_LESS_V3
	default 199 if ESP32P4_SELECTS_REV_LESS_V3

# keep in sync the "Maximum Supported Revision" description with this value

config ESP_REV_MAX_FULL
	int
	default ESP32P4_REV_MAX_FULL

config ESP_EFUSE_BLOCK_REV_MIN_FULL
	int "Minimum Supported ESP32-P4 eFuse Block Revision"
	default 0
	---help---
		Required minimum eFuse Block revision. ESP-IDF will check it at the 2nd bootloader stage
		whether the current image can work correctly for this eFuse Block revision.
		So that to avoid running an incompatible image on a SoC that contains breaking change in the eFuse Block.
		If you want to update this value to run the image that not compatible with the current eFuse Block revision,
		please contact to Espressif's business team for details:
		https://www.espressif.com.cn/en/contact-us/sales-questions

config ESP_EFUSE_BLOCK_REV_MAX_FULL
	int
	default 199
	comment "Maximum Supported ESP32-P4 eFuse Block Revision (eFuse Block Rev v0.99)"

# The revision in the comment must correspond to the default value of ESP_EFUSE_BLOCK_REV_MAX_FULL

menu "Cache config"

choice ESPRESSIF_CACHE_L2_CACHE_SIZE_SELECT
	prompt "L2 cache size"
	default ESPRESSIF_CACHE_L2_CACHE_256KB
	---help---
		L2 cache size to be set on application startup.

config ESPRESSIF_CACHE_L2_CACHE_128KB
	bool "128KB"

config ESPRESSIF_CACHE_L2_CACHE_256KB
	bool "256KB"

config ESPRESSIF_CACHE_L2_CACHE_512KB
	bool "512KB"

endchoice # ESPRESSIF_CACHE_L2_CACHE_SIZE_SELECT

config ESPRESSIF_CACHE_L2_CACHE_SIZE
	hex
	default 0x20000 if ESPRESSIF_CACHE_L2_CACHE_128KB
	default 0x40000 if ESPRESSIF_CACHE_L2_CACHE_256KB
	default 0x80000 if ESPRESSIF_CACHE_L2_CACHE_512KB

choice ESPRESSIF_CACHE_L2_CACHE_LINE_SIZE_SELECT
	prompt "L2 cache line size"
	default ESPRESSIF_CACHE_L2_CACHE_LINE_64B if ESPRESSIF_CACHE_L2_CACHE_128KB
	default ESPRESSIF_CACHE_L2_CACHE_LINE_64B if ESPRESSIF_CACHE_L2_CACHE_256KB
	default ESPRESSIF_CACHE_L2_CACHE_LINE_128B if ESPRESSIF_CACHE_L2_CACHE_512KB
	---help---
		L2 cache line size to be set on application startup.

config ESPRESSIF_CACHE_L2_CACHE_LINE_64B
	bool "64 Bytes"
	depends on ESPRESSIF_CACHE_L2_CACHE_128KB || ESPRESSIF_CACHE_L2_CACHE_256KB

config ESPRESSIF_CACHE_L2_CACHE_LINE_128B
	bool "128 Bytes"

endchoice # ESPRESSIF_CACHE_L2_CACHE_LINE_SIZE_SELECT

config ESPRESSIF_CACHE_L2_CACHE_LINE_SIZE
	int
	default 64 if ESPRESSIF_CACHE_L2_CACHE_LINE_64B
	default 128 if ESPRESSIF_CACHE_L2_CACHE_LINE_128B

config ESPRESSIF_CACHE_L1_CACHE_LINE_SIZE
	int
	default 64

endmenu # Cache config

config P4_REV3_MSPI_CRASH_AFTER_POWER_UP_WORKAROUND
	bool
	default y if ESP32P4_REV_MIN_300

config P4_REV3_MSPI_WORKAROUND_SIZE
	hex
	default 0x100 if ESP32P4_REV_MIN_300
	default 0

menuconfig ESP32P4_SDMMC
	bool "ESP32P4 SDMMC Host Controller"
	default n
	depends on SCHED_WORKQUEUE && SCHED_HPWORK
	select ARCH_HAVE_SDIO
	select SDIO_DMA if MMCSD
	select SDIO_BLOCKSETUP if MMCSD_SDIO
	select SDIO_MUXBUS if MMCSD_SDIO
	---help---
		Enable the ESP32P4 SDMMC host controller driver.  This driver
		implements the NuttX SDIO interface (struct sdio_dev_s) for the
		DesignWare MCI IP core found on the ESP32P4.  It supports two
		slots:  slot 0 uses IOMUX (fixed pins for TF card) and slot 1
		uses the GPIO matrix (for ESP-Hosted SDIO communication with
		ESP32-C6 co-processor).

if ESP32P4_SDMMC

config ESP32P4_SDMMC_SLOT0
	bool "Enable SDMMC Slot 0 (IOMUX)"
	default y
	---help---
		Enable SDMMC slot 0 which uses IOMUX fixed pins.  Typically
		used for external TF card.

config ESP32P4_SDMMC_SLOT1
	bool "Enable SDMMC Slot 1 (GPIO Matrix)"
	default y
	---help---
		Enable SDMMC slot 1 which uses GPIO matrix for pin routing.
		Typically used for ESP-Hosted SDIO communication with
		ESP32-C6 co-processor.

config ESP32P4_SDMMC_SLOT1_PIN_CLK
	int "Slot 1 CLK GPIO Pin"
	default 18
	---help---
		GPIO pin number for SDMMC slot 1 clock signal.

config ESP32P4_SDMMC_SLOT1_PIN_CMD
	int "Slot 1 CMD GPIO Pin"
	default 19
	---help---
		GPIO pin number for SDMMC slot 1 command signal.

config ESP32P4_SDMMC_SLOT1_PIN_D0
	int "Slot 1 D0 GPIO Pin"
	default 14
	---help---
		GPIO pin number for SDMMC slot 1 data line 0.

config ESP32P4_SDMMC_SLOT1_PIN_D1
	int "Slot 1 D1 GPIO Pin"
	default 15
	---help---
		GPIO pin number for SDMMC slot 1 data line 1.

config ESP32P4_SDMMC_SLOT1_PIN_D2
	int "Slot 1 D2 GPIO Pin"
	default 16
	---help---
		GPIO pin number for SDMMC slot 1 data line 2.

config ESP32P4_SDMMC_SLOT1_PIN_D3
	int "Slot 1 D3 GPIO Pin"
	default 17
	---help---
		GPIO pin number for SDMMC slot 1 data line 3.

endif # ESP32P4_SDMMC


endif # ARCH_CHIP_CUSTOM
```

## chip/esp32p4/espressif/esp_hosted/Kconfig
```kconfig
#
# For a description of the syntax of this configuration file,
# see the file kconfig-language.txt in the NuttX tools repository.
#

menuconfig ESP_HOSTED
	bool "ESP-Hosted Wi-Fi Co-processor Support"
	default n
	depends on ARCH_CHIP_ESP32P4
	---help---
		Enable ESP-Hosted to use an ESP32-C6 (or other ESP chip) as a
		Wi-Fi/Bluetooth co-processor over SPI, SDIO, or UART transport.

if ESP_HOSTED

choice ESP_HOSTED_TRANSPORT
	prompt "Transport interface"
	default ESP_HOSTED_SDIO
	---help---
		Select the transport bus between ESP32-P4 (Host) and ESP co-processor.

	config ESP_HOSTED_SDIO
		bool "SDIO"
		---help---
			SDIO 4-bit mode. Highest performance (~80 Mbps UDP).

	config ESP_HOSTED_SPI
		bool "SPI Full-duplex"
		depends on ESPRESSIF_SPI
		---help---
			Standard SPI full-duplex. Good balance of simplicity and throughput.

	config ESP_HOSTED_UART
		bool "UART"
		---help---
			UART transport. Simplest, lowest throughput (~0.7 Mbps).

endchoice

# ---- SPI 配置 ----
if ESP_HOSTED_SPI

config ESP_HOSTED_SPI_BUS
	int "SPI bus number"
	default 1
	---help---
		Which SPI bus to use (0 or 1 on ESP32-P4).

config ESP_HOSTED_SPI_FREQ_MHZ
	int "SPI clock frequency (MHz)"
	default 10
	range 1 40
	---help---
		SPI clock frequency. Start low (10 MHz) for debugging.

config ESP_HOSTED_SPI_GPIO_CS
	int "SPI CS GPIO"
	default 7
	---help---
		GPIO pin for SPI chip select.

config ESP_HOSTED_SPI_GPIO_HANDSHAKE
	int "Handshake GPIO"
	default 6
	---help---
		GPIO for host->slave handshake signal.

config ESP_HOSTED_SPI_GPIO_DATA_READY
	int "Data Ready GPIO"
	default 11
	---help---
		GPIO for slave->host data ready interrupt.

endif # ESP_HOSTED_SPI

# ---- SDIO 配置 ----
if ESP_HOSTED_SDIO

config ESP_HOSTED_SDIO_SLOT
	int "SDIO slot"
	default 1
	---help---
		SDIO slot to use. Slot 1 connects to on-board ESP32-C6
		on ESP32-P4-Function-EV-Board.

config ESP_HOSTED_SDIO_FREQ_KHZ
	int "SDIO clock frequency (kHz)"
	default 40000
	range 400 50000
	---help---
		SDIO clock frequency.

config ESP_HOSTED_SDIO_BUS_WIDTH_4BIT
	bool "Use 4-bit SDIO bus"
	default y
	---help---
		Use 4-bit bus width for higher throughput.

endif # ESP_HOSTED_SDIO

# ---- UART 配置 ----
if ESP_HOSTED_UART

config ESP_HOSTED_UART_PORT
	int "UART port number"
	default 1
	---help---
		Which UART port to use for ESP-Hosted communication.

config ESP_HOSTED_UART_BAUDRATE
	int "UART baud rate"
	default 921600
	---help---
		Baud rate. Higher = more throughput, less reliability.

endif # ESP_HOSTED_UART

# ---- 通用配置 ----
config ESP_HOSTED_GPIO_RESET_SLAVE
	int "Slave reset GPIO"
	default 54
	---help---
		GPIO connected to the ESP co-processor RST/EN pin.

config ESP_HOSTED_USE_MEMPOOL
	bool "Use mempool for transport buffers"
	default y
	---help---
		Use memory pool for buffer allocation instead of malloc.

config ESP_HOSTED_TASK_STACK_SIZE
	int "ESP-Hosted task stack size"
	default 4096
	---help---
		Stack size for the ESP-Hosted RPC task.

config ESP_HOSTED_TASK_PRIORITY
	int "ESP-Hosted task priority"
	default 100
	---help---
		Priority for the ESP-Hosted tasks.

config ESP_HOSTED_MAX_SYNC_RPC_REQUESTS
	int "Max simultaneous sync RPC requests"
	default 5
	---help---
		Maximum number of simultaneous synchronous RPC requests.

config ESP_HOSTED_MAX_ASYNC_RPC_REQUESTS
	int "Max simultaneous async RPC requests"
	default 5
	---help---
		Maximum number of simultaneous asynchronous RPC requests.

config ESP_HOSTED_SPI_TX_Q_SIZE
	int "SPI TX queue size"
	default 10
	depends on ESP_HOSTED_SPI
	---help---
		SPI transport TX queue size.

config ESP_HOSTED_SPI_RX_Q_SIZE
	int "SPI RX queue size"
	default 10
	depends on ESP_HOSTED_SPI
	---help---
		SPI transport RX queue size.

config ESP_HOSTED_SDIO_TX_Q_SIZE
	int "SDIO TX queue size"
	default 10
	depends on ESP_HOSTED_SDIO
	---help---
		SDIO transport TX queue size.

config ESP_HOSTED_SDIO_RX_Q_SIZE
	int "SDIO RX queue size"
	default 10
	depends on ESP_HOSTED_SDIO
	---help---
		SDIO transport RX queue size.

config ESP_HOSTED_UART_TX_Q_SIZE
	int "UART TX queue size"
	default 10
	depends on ESP_HOSTED_UART
	---help---
		UART transport TX queue size.

config ESP_HOSTED_UART_RX_Q_SIZE
	int "UART RX queue size"
	default 10
	depends on ESP_HOSTED_UART
	---help---
		UART transport RX queue size.

endif # ESP_HOSTED
```
